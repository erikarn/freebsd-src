## local/test.its
```
/dts-v1/;

// Load at offset 0x81000000 (16mb)
// FDT for now is 0x83000000 (48mb) - I'm not sure yet if it's used or needed
// Empty ramdisk for now

/ {
        description = "ARM FreeBSD-HEAD AC1300 FIT Image";
        #address-cells = <1>;

        images {
                kernel@1 {
                        description = "Kernel";
                        data = /incbin/("../../kernel.elf.lzma");
                        type = "kernel";
                        arch = "arm";
                        os = "linux";
                        compression = "lzma";
                        load = <0x81000000>;
                        entry = <0x81000200>;
                        hash@1 {
                                algo = "crc32";
                        };
                        hash@2 {
                                algo = "sha1";
                        };
                };
                fdt@1 {
                        description = "DTB";
                        data = /incbin/("../../qcom-ipq4018-rt-ac58u.dtb");
                        type = "flat_dt";
                        arch = "arm";
                        compression = "none";
                        hash@1 {
                                algo = "crc32";
                        };
                        hash@2 {
                                algo = "sha1";
                        };
                };
//                initrd {
//                        description = "Initrd";
//                        data = /incbin/("../../ramdisk.bin");
//                        type = "ramdisk";
//                        arch = "arm";
//                        os = "linux";
//                        load = <0x0>;
//                        compression = "none";
//                        hash {
//                                algo = "sha1";
//                        };
//                };
        };

        configurations {
                default = "config@1";
                config@1 {
                        description = "Standard Boot";
                        kernel = "kernel@1";
                        fdt = "fdt@1";
//                        ramdisk = "initrd";
                };
        };

};
```
